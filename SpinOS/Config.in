## SpinOS/Config.in
```kconfig
source "$BR2_EXTERNAL_SPINOS_PATH/package/spinproj/Config.in"
source "$BR2_EXTERNAL_SPINOS_PATH/package/spinpi/Config.in"
```

## SpinOS/package/spinpi/Config.in
```kconfig
config BR2_PACKAGE_SPINPI
	bool "spinpi"
	depends on BR2_PACKAGE_PYTHON3
	select BR2_PACKAGE_PYTHON_SERIAL
	select BR2_PACKAGE_SPINPROJ
	help
	  The printer service: web page, USB sticks, ESP32 link, print jobs.
	  Part of SpinSlicer.

comment "spinpi needs python3"
	depends on !BR2_PACKAGE_PYTHON3
```

## SpinOS/package/spinproj/Config.in
```kconfig
config BR2_PACKAGE_SPINPROJ
	bool "spinproj"
	depends on BR2_TOOLCHAIN_HAS_THREADS
	select BR2_PACKAGE_LZ4
	select BR2_PACKAGE_LIBDRM
	help
	  Shows the frame that belongs to the vial angle on every vsync
	  (DRM/KMS page flip). Part of SpinSlicer.
```
